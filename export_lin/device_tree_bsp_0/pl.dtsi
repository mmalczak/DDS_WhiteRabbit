/*
 * CAUTION: This file is automatically generated by Xilinx.
 * Version:  
 * Today is: Tue Feb 20 15:25:05 2018
*/


/ {
	amba_pl: amba_pl {
		#address-cells = <1>;
		#size-cells = <1>;
		compatible = "simple-bus";
		ranges ;
		axil2wb_0: axil2wb@43c00000 {
			compatible = "xlnx,axil2wb-1.0";
			reg = <0x43c00000 0x10000>;
		};
	};
};
